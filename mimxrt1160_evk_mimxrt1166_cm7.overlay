/* Disable Ethernet MAC controller */
&enet_mac {
	status = "disabled";
};

/* Disable MDIO interface */
&enet_mdio {
	status = "disabled";
};

/* Disable the ethernet PHY */
&enet_ptp_clock {
	status = "disabled";
}; 